## kria_port/project-spec/meta-user/recipes-bsp/u-boot/files/kria_dhcp_defconfig
```kconfig
# Environment support
CONFIG_ENV_SUPPORT=y
CONFIG_ENV=y
CONFIG_SYS_REDUNDAND_ENVIRONMENT=y
CONFIG_ENV_IS_NOWHERE=y
CONFIG_ENV_SIZE=0x2000
CONFIG_ENV_OFFSET=0
CONFIG_ENV_OFFSET_REDUND=0

# Environment commands
CONFIG_CMD_ENV=y
CONFIG_CMD_SAVEENV=y
CONFIG_CMD_EDITENV=y
CONFIG_CMD_EXPORTENV=y
CONFIG_CMD_IMPORTENV=y

# Environment flags and callbacks
CONFIG_REGEX=y
CONFIG_ENV_FLAGS_LIST_DEFAULT=y
CONFIG_ENV_CALLBACK_LIST_DEFAULT=y
CONFIG_ENV_OVERWRITE=y
CONFIG_USE_DEFAULT_ENV_FILE=y

# Network and DHCP
CONFIG_CMD_DHCP_CLIENT_ID=y
CONFIG_CMD_DHCP=y
CONFIG_CMD_NFS=y
CONFIG_CMD_PING=y
CONFIG_NET=y
CONFIG_IP_DEFRAG=y
CONFIG_PROT_TCP=y

# SPI Flash
CONFIG_DM_SPI=y
CONFIG_DM_SPI_FLASH=y
CONFIG_SPI_FLASH=y
CONFIG_SPI_FLASH_BAR=y
CONFIG_SPI=y
CONFIG_CMD_SF=y
CONFIG_CMD_SPI=y

# Additional required configs
CONFIG_LIB_UUID=y
CONFIG_PARTITION_UUIDS=y
CONFIG_CMD_PART=y
CONFIG_CMD_FAT=y
CONFIG_FS_FAT=y
```

## t/patch/Kconfig
```kconfig
# Copyright (c) 2018, Xilinx, Inc.
#
# SPDX-License-Identifier: GPL-2.0

if ARCH_ZYNQMP

config CMD_DHCP_CLIENT_ID
	bool "dhcp_client_id"
	default y
	help
	  This command builds CMS/HPM.3 compliant DHCP Client ID
	  and sets MAC addresses for Kria SOM. Required for
	  early network configuration with NFS rootfs.

config CMD_ZYNQMP
	bool "Enable ZynqMP specific commands"
	default y
	help
	  Enable ZynqMP specific commands like "zynqmp secure"
	  which is used for zynqmp secure image verification.
	  The secure image is a xilinx specific BOOT.BIN with
	  either authentication or encryption or both encryption
	  and authentication feature enabled while generating
	  BOOT.BIN using Xilinx bootgen tool.

endif
```
